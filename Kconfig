## Kconfig
```kconfig
menu "AWS IoT Shadow"
    config AWS_IOT_SHADOW_SUPPORT_DELTA
        bool "Listen to /update/delta messages"
        default y

    config CONFIG_AWS_IOT_SHADOW_SUPPORT_DELETE
        bool "Listen to /delete/* messages"
        default y
endmenu
```

## example/main/Kconfig.projbuild
```kconfig
menu "Example config"

    config EXAMPLE_WIFI_CONFIG
        bool "Override and store WiFI config"
        default n

    config EXAMPLE_WIFI_SSID
        string "WiFi SSID"
        default ""
        depends on EXAMPLE_WIFI_CONFIG
        help
            SSID (network name) for the example to connect to.

    config EXAMPLE_WIFI_PASSWORD
        string "WiFi Password"
        default ""
        depends on EXAMPLE_WIFI_CONFIG
        help
            WiFi password (WPA, WPA2 or WPA3) for the example to use.

    choice EXAMPLE_AWS_IOT_MQTT_TRANSPORT
        prompt "AWS IoT MQTT transport type"
        default EXAMPLE_AWS_IOT_MQTT_TRANSPORT_SSL

        config EXAMPLE_AWS_IOT_MQTT_TRANSPORT_UNKNOWN
            bool "Unknown"
        config EXAMPLE_AWS_IOT_MQTT_TRANSPORT_TCP
            bool "MQTT over TCP, using scheme mqtt"
        config EXAMPLE_AWS_IOT_MQTT_TRANSPORT_SSL
            bool "MQTT over SSL, using scheme mqtts"
        config EXAMPLE_AWS_IOT_MQTT_TRANSPORT_WS
            bool "MQTT over Websocket, using scheme ws"
        config EXAMPLE_AWS_IOT_MQTT_TRANSPORT_WSS
            bool "MQTT over Websocket Secure, using scheme wss"
    endchoice

    config EXAMPLE_AWS_IOT_MQTT_TRANSPORT
        int
        default 1 if EXAMPLE_AWS_IOT_MQTT_TRANSPORT_TCP
        default 2 if EXAMPLE_AWS_IOT_MQTT_TRANSPORT_SSL
        default 3 if EXAMPLE_AWS_IOT_MQTT_TRANSPORT_WS
        default 4 if EXAMPLE_AWS_IOT_MQTT_TRANSPORT_WSS
        default 0

    config EXAMPLE_AWS_IOT_MQTT_PORT
        int "AWS IoT MQTT port"
        default 0
        help
            MQTT port, 0 to use transport default (configured in MQTT component).

    config EXAMPLE_AWS_IOT_MQTT_HOST
        string "AWS IoT MQTT host"
        default ""
        help
            Your AWS hostname, can be found on the thing detail.

    config EXAMPLE_AWS_IOT_MQTT_CLIENT_ID
        string "AWS IoT MQTT client ID"
        default ""
        help
            Usually found on the thing detail.
endmenu
```

## example/sdkconfig.defaults
```kconfig
CONFIG_LOG_DEFAULT_LEVEL_DEBUG=y

# AWS Iot Shadow
CONFIG_AWS_IOT_SHADOW_SUPPORT_DELTA=y
CONFIG_AWS_IOT_SHADOW_SUPPORT_DELETE=y

# Disable insecure TLS
CONFIG_MBEDTLS_SSL_PROTO_TLS1=n
CONFIG_MBEDTLS_SSL_PROTO_TLS1_1=n

# Increase MQTT buffer
CONFIG_MQTT_USE_CUSTOM_CONFIG=y
CONFIG_MQTT_BUFFER_SIZE=2048
```
